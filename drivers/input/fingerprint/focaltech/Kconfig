## drivers/input/fingerprint/focaltech/Kconfig
```kconfig
config FOCALTECH_FINGERPRINT
	depends on MACH_ASUS_X01BD
	tristate "generic focaltech fingerprint driver"
	default y
	help
	add support for focaltech fingerprint driver.
```
