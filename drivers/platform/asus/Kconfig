## drivers/platform/asus/Kconfig
```kconfig
menu "ASUS Snapdragon 660/636 Platform"

config MACH_ASUS
	bool "ASUS devices"
	help
	  This enables support for ASUS devices.

if MACH_ASUS

config MACH_ASUS_SDM660
	bool
	select ARCH_QCOM
	select ARCH_SDM660

choice
	prompt "ASUS device"
	default MACH_ASUS_DUMMY

config MACH_ASUS_DUMMY
	bool "Dummy device"
	help
	  A stub configuration that doesn't enable support for anything.

config MACH_ASUS_X00TD
	bool "ZenFone Max Pro (M1)"
	select MACH_ASUS_SDM660
	help
	  This enables support for ASUS ZenFone Max Pro (M1).

config MACH_ASUS_X01BD
	bool "ZenFone Max Pro (M2)"
	select MACH_ASUS_SDM660
	help
	  This enables support for ASUS ZenFone Max Pro (M2).

endchoice

endif

endmenu
```
